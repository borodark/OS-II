/**
 * P2 flow compiler verification: run generated bytecode on host.
 *
 * Loads the flow-compiled sensor + actuator programs, spawns both
 * in the scheduler, and verifies sensor reads are forwarded to
 * the actuator via SEND/RECV_CMD.
 */

#include <stdio.h>

#include "mb_vm.h"
#include "mb_scheduler.h"

/* Include the generated flow header */
#include "flow_generated.h"

static int failures = 0;

static void check_int(const char *name, int expected, int actual) {
    if (expected != actual) {
        fprintf(stderr, "FAIL %s: expected=%d actual=%d\n", name, expected, actual);
        failures++;
    }
}

int main(void) {
    mb_scheduler_t sched;
    mb_pid_t pid_sensor, pid_actuator;
    mb_process_t *ps, *pa;
    int rc, ticks = 0;

    mb_sched_init(&sched);
    pid_sensor = mb_sched_spawn(&sched, os2_flow_sensor_prog,
                                 sizeof(os2_flow_sensor_prog));
    pid_actuator = mb_sched_spawn(&sched, os2_flow_actuator_prog,
                                   sizeof(os2_flow_actuator_prog));

    check_int("sensor_pid", 1, pid_sensor);
    check_int("actuator_pid", 2, pid_actuator);

    ps = mb_sched_proc(&sched, pid_sensor);
    pa = mb_sched_proc(&sched, pid_actuator);

    /* Run scheduler until both processes have executed at least one cycle */
    while (ticks < 200) {
        rc = mb_sched_tick(&sched);
        if (rc == MB_SCHED_IDLE) {
            break;
        }
        if (rc != MB_OK) {
            fprintf(stderr, "sched error rc=%d tick=%d\n"
                    "  sensor:   state=%d err=%d pc=%zu\n"
                    "  actuator: state=%d err=%d pc=%zu\n",
                    rc, ticks,
                    ps->state, ps->last_error, ps->pc,
                    pa->state, pa->last_error, pa->pc);
            return 1;
        }
        ticks++;
    }

    /* Sensor should have read I2C and sent to actuator.
     * Stub HAL: i2c_read(bus=1, addr=0x39, reg=0x92) = 0x39 ^ 0x92 ^ 1 = 0xAA = 170
     * Actuator should have received PWM_SET_DUTY and called pwm_set_duty. */
    printf("flow_host: %d ticks\n", ticks);
    printf("  sensor:   state=%d r7(value)=%d r9(ts)=%d\n",
           ps->state, MB_GET_SMALLINT(ps->regs[7]), MB_GET_SMALLINT(ps->regs[9]));
    printf("  actuator: state=%d r0(type)=%d r1(ch)=%d r2(duty)=%d r5(rc)=%d\n",
           pa->state, MB_GET_SMALLINT(pa->regs[0]),
           MB_GET_SMALLINT(pa->regs[1]), MB_GET_SMALLINT(pa->regs[2]),
           MB_GET_SMALLINT(pa->regs[5]));

    /* Verify actuator received the right command */
    check_int("actuator_cmd_type", 2, MB_GET_SMALLINT(pa->regs[0])); /* PWM_SET_DUTY */
    check_int("actuator_channel", 0, MB_GET_SMALLINT(pa->regs[1]));
    /* Stub: value = addr ^ reg ^ bus = 0x39 ^ 0x92 ^ 1 = 0xAA = 170 */
    check_int("actuator_duty", 170, MB_GET_SMALLINT(pa->regs[2]));

    if (failures != 0) {
        fprintf(stderr, "flow_host failures=%d\n", failures);
        return 1;
    }

    printf("mini_beam_host_flow: compiled flow verified -- PASS\n");
    return 0;
}
